## app/project/Kconfig.proj
```kconfig
#APP specific configuration.
config BF0_HCPU
    bool
    default y

config CUSTOM_MEM_MAP
    bool 
	select custom_mem_map
	default y    

config XIAOZHI_USING_MQTT
    bool "xiaozhi_using_mqtt"
	default n

config CONFIG_IOT_PROTOCOL_MCP
    bool "using mcp protocol"
	default y 

comment "------------Project configuration-----------"



config BLUETOOTH_NAME
    string "Bluetooth device name"
    default "sifli-pan"
    help
        Specify the Bluetooth device name for the application.

config BT_NAME_MAC_ENABLE
    bool "Append the MAC address to the Bluetooth name"
    default n
    help
        Append the MAC address to the Bluetooth name, such as "sifli-pan-12:34:56:78:9a:bc".

# KWS
config KWS_ENABLE_DEFAULT
    bool "Enable KWS by default"
    default n
    help
        Enable KWS (Keyword Spotting) by default in the application. 


# EZIP
config EZIP_BINARY_MODE
    bool "Enable EZIP binary mode"
    depends on BSP_USING_BOARD_SF32LB52_NANO_A128R16
    default y
    help
        Enable EZIP binary mode for image resources.
# TINY_TTF
config TINY_TTF_MODE
    bool "Enable Tiny TTF font support"
    depends on BSP_USING_BOARD_SF32LB52_NANO_A128R16
    default y
    help
        Enable Tiny TTF font support for the application.

config LOW_POWER_NO_SHUTDOWN
    bool "low power dont shutdown"
    default n

config BSP_USING_MOTOR_APP
    bool "Enable motor control module (app)"
    default n
    help
        Enable dual DC motor control via TB6612 driver.
        Provides speed/position PID control and finsh command interface.

if BSP_USING_MOTOR_APP

config MOTOR_TOTAL_PPR
    int "Total encoder PPR (with gear ratio and quadrature)"
    default 1061
    help
        Total pulses per motor shaft revolution, including gear reduction
        and 4x quadrature decoding.
        Formula: TOTAL_PPR = encoder_PPR * gear_ratio * 4
        Example: MG310 -> 13 * 20.409 * 4 = 1061

config MOTOR_MAX_RPM
    int "Maximum motor speed (RPM)"
    default 300
    help
        Maximum allowed motor speed in RPM for PID control limit.

endif
```

## app/project/Kconfig.tmp
```kconfig
source "D:/SiFli/xiaozhi/xiaozhi-sf32/app/boards/sf32lb52-xiaozhi-M/hcpu/Kconfig.board"
source "$SIFLI_SDK/customer/boards/Kconfig.v2"
source "$SIFLI_SDK/Kconfig.v2"
orsource "sf-pkgs/Kconfig.conandeps"
rsource "Kconfig.proj"
```
